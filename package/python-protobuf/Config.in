## package/python-protobuf/Config.in
```kconfig
config BR2_PACKAGE_PYTHON_PROTOBUF
	bool "python-protobuf"
	help
	  Python implementation of the Google Protocol Buffers.

	  Protocol buffers are Google's language-neutral,
	  platform-neutral, extensible mechanism for serializing
	  structured data.

	  https://developers.google.com/protocol-buffers
```
